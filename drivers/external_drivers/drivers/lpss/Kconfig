## drivers/external_drivers/drivers/lpss/Kconfig
```kconfig
#
# LPSS DMA device configuration
#
config LPSS_DMA
	tristate "LPSS DMA support"
	default n
	help
	  Enable support for the Intel(R) LPSS DMA in Intel
	  MID chipsets.

	  Say Y here if you have such a chipset.

	  If unsure, say N.

config BYT_LPSS_DMA
	tristate "BYT LPSS DMA support"
	default n
	depends on LPSS_DMA
	help
	  Baytrail and Cherrytrail LPSS DMA enable
```

## drivers/external_drivers/drivers/mfd/Kconfig
```kconfig
#
# Multifunction miscellaneous devices
#

config CRYSTAL_COVE
	bool "Support for Intel ValleyView Crystal Cove"
	depends on I2C=y
	select MFD_CORE
	help
	  Select this option to enable access to Intel
	  ValleyView PMIC chip.

	  This chip embeds ADC, GPIO, Thermals, Charge, etc.
	  Devices are used in Intel Baytrail platforms.

	  Crystal Cove driver is a multi function driver which
	  supports to create all sub-devices inside PMIC.
	  And it also provides IRQ dispatch function to
	  sub-device drivers.

config INTEL_MID_PMIC
	bool "Support for Intel MID PMIC"
	depends on I2C=y
	select MFD_CORE
	help
	  Select this option to enable support of Intel
	  PMIC chip.

	  PMIC chip embeds ADC, GPIO, Thermals, Charge, etc.
	  Devices are used in Intel platforms.

	  PMIC driver is a multi function driver which
	  supports to create all sub-devices inside PMIC.
	  And it also provides IRQ dispatch function to
	  sub-device drivers.

config PLATFORM_BTNS
	bool "Support Intel Brighton Shores Platform"
	default n
	help
	  PLEASE DO NOT USE this anymore. It'll be removed soon.
	  Select this option to enable support of Brighton Shores.
	  It's temmprary definition for bring up work. Please do not use
	  this in your code anymore.

config BTNS_PMIC
	bool "Support for Brighton Shores Intel PMIC features"
	depends on I2C=y
	select MFD_CORE
	default n
	help
	  Select this option to enable support of Brighton Shores specific PMIC
	  changes. BTNS has Dollar Cove PMIC and several features for PMIC
	  need to have BTNS PMIC specific changes on adc, regulator, pupdr, battery,
	  charger and power management.
```

## drivers/external_drivers/drivers/misc/Kconfig
```kconfig
config A1026
	tristate "Audience a1026/eS305 Voice Processor"
	depends on I2C && INTEL_SCU_IPC
	help
	  Provides an interface to the Audience voice processing
	  unit via an I2C bus interface.

	  To compile this driver as a module, choose M here: the module will
	  be called a1026.

config SCU_LOGGING
	tristate "Intel SCU fabric debug driver"
	default n
	---help---
	 Driver that enable for debugging Intel SCU firmware fabric related error.

config UUID
	tristate "get uuid"
	default n
	---help---
	 Driver for get UUID.

config EMMC_IPANIC
	bool "Intel kernel panic diagnostics driver FOR EMMC"
	default n
	---help---
	  Driver which handles kernel panics and attempts to write
	  critical debugging data to a dedicated partition on EMMC.

config EMMC_IPANIC_PLABEL
	string "Intel kernel panic driver (EMMC_IPANIC) partition label"
	depends on EMMC_IPANIC
	default "panic"
	---help---
	  Set the default mmc partition label for EMMC_IPANIC driver.

config SENSORS_APDS990X_FORK
	 tristate "APDS990X combined als and proximity sensors"
	 depends on I2C
	 default n
	 ---help---
	   Say Y here if you want to build a driver for Avago APDS990x
	   combined ambient light and proximity sensor chip.

	   To compile this driver as a module, choose M here: the
	   module will be called apds990x. If unsure, say N here.

config KCT_DAEMON
	tristate "Intel Kernel Crash Tool daemon"
	default n
	---help---
	 Driver that enables the kct daemon to handle Intel crashtool events.

config FPS_THROTTLE
	tristate "register a new cooling device for FPS throttling"
	depends on THERMAL
	---help---
	  register a new cooling device for FPS throttling.

config KL03_HINGE
	tristate "KL03 Hinge Driver"
	depends on I2C && SYSFS
	---help---
	  Driver for KL03 Hinge

source "drivers/external_drivers/drivers/misc/bcm-lpm/Kconfig"
source "drivers/external_drivers/drivers/misc/intel_ld/Kconfig"
source "drivers/external_drivers/drivers/misc/ti-st/Kconfig"
source "drivers/external_drivers/drivers/misc/tp2l/Kconfig"
source "drivers/external_drivers/drivers/misc/iqvandroid/Kconfig"
source "drivers/external_drivers/drivers/misc/rawio/Kconfig"
source "drivers/external_drivers/drivers/misc/tp2e/Kconfig"
```

## drivers/external_drivers/drivers/misc/ti-st/Kconfig
```kconfig
#
# TI's shared transport line discipline and the protocol
# drivers (BT, FM and GPS)
#
menu "Fork of Texas Instruments shared transport line discipline"
config TI_ST_FORK
	tristate "Forked shared transport core driver"
	depends on NET && GPIOLIB && !TI_ST
	select FW_LOADER
	help
	  This enables the shared transport core driver for TI
	  BT / FM and GPS combo chips. This enables protocol drivers
	  to register themselves with core and send data, the responses
	  are returned to relevant protocol drivers based on their
	  packet types.

config ST_HCI_FORK
	tristate "Forked HCI TTY emulation driver for Bluetooth"
	depends on TI_ST_FORK
	help
	  This enables the TTY device like emulation for HCI used by
	  user-space Bluetooth stacks.
	  It will provide a character device for user space Bluetooth stack to
	  send/receive data over shared transport.

endmenu
```

## drivers/external_drivers/drivers/misc/tp2l/Kconfig
```kconfig
config TRACEPOINT_TO_LOG
       tristate "Tracepoint binding to T&D logging infrastructure (TP2L)"
       depends on TRACEPOINTS && DEBUG_FS && INTEL_MID_PTI
       help
         This module enables binding between tracepoints and T&D logging
	 infrastructure (via PTD driver).
	 A new TP2L probe (allowing the binding) is automatically defined at
	 precompilation time for each tracepoint (TRACE_EVENT) that is declared
	 in the trace header files that are included in the TP2L module. The module
	 also gives a way to enable/disable the TP2L probe for each tracepoint event.
```

## drivers/external_drivers/drivers/modem_ap_cdmp/Kconfig
```kconfig
#
# Modem Core Dump by AP
# Perform gpio_06 to request 7262 coredump on IMC modems
#

config MDM_APCDMP
	tristate "Modem AP CORE DUMP driver"
	default y
	---help---
          The modem control driver for IMC modems. This driver will test in NFC verified
	  This is only test
          Verified for XMM6260, XMM7160, XMM6360 and XMM 6263 modems.
```

## drivers/external_drivers/drivers/nfc/Kconfig
```kconfig
#
# Near Field Communication (NFC) devices
#

config NFC_PN544_PLATFORM_DATA
       bool "Enable PN544 NFC platform data"
       ---help---
        Enables NFC PN544 platform file, required by PN544 I2C driver

source "drivers/external_drivers/drivers/nfc/intel/Kconfig"
```

## drivers/external_drivers/drivers/nfc/intel/Kconfig
```kconfig
#
# Near Field Communication (NFC) devices
#

config NFC_FDP_PLATFORM_DATA
       bool "Enable FDP NFC platform data"
       ---help---
        Enables NFC FDP platform file, required by FDP I2C driver
```

## drivers/external_drivers/drivers/pinctrl/Kconfig
```kconfig
#
# PINCTRL infrastructure and drivers
#

config PINCTRL_INTEL_MID
	tristate "Intel MID pin controller driver"
	depends on X86_INTEL_MID && INTEL_SCU_FLIS
	select GENERIC_PINCONF
```

## drivers/external_drivers/drivers/platform/x86/Kconfig
```kconfig
#
# X86 Platform Specific Drivers
#
config GPIO_INTEL_MSIC
	bool "Intel MSIC GPIO support"
	depends on INTEL_SCU_IPC && GPIOLIB
	---help---
	  MSIC provides a GPIO subsystem containing several input
	  output pins.
	  Say Y here to support GPIO via the SCU IPC interface
	  on Intel MID platforms.

config INTEL_MID_OSNIB_ILB
        tristate "cmos osnib driver for Intel BYT platforms"
	depends on INTEL_REBOOT_TARGET
        default n
        ---help---
			This driver adds OSNIB support using CMOS.
			OSNIB is used to share flags between firmware and kernel.
			This is only valid when no SCU is present.

			If unsure, say N.

config INTEL_MID_OSIP
	tristate "osip driver for Intel MID platforms"
	default y
	help
	  This driver modifies the osip header when rebooting,
	  so that one can type 'reboot bootloader' to fall back
	  in kboot mode.

	  If unsure, say N.

config INTEL_MID_OSIP_DEBUG_FS
	tristate "osip driver debug fs"
	depends on INTEL_MID_OSIP && DEBUG_FS
	default y
	help
	  This driver adds debugfs interface.
	  The main feature of that interface is to be able to modify the kernel
	  cmdline directly in the OSIP.
	  This has to be disabled if we have secure boot enabled by default.

	  If unsure, say N.

config INTEL_PSH_IPC
	bool "Intel PSH IPC Support"
	depends on X86_INTEL_MID
	---help---
	  PSH(Platform Services Hub) is a low frequence IA core on Tangier Platform,
	  whose power consumption is quite low. PSH runs RTOS software inside itself,
	  which independently controls and collects sensor data, pre-processes the data,
	  and communicates with Atom. Thus ATOM side could be put into low power mode
	  with more time, while all the sensor data are collected without any lost.

	  PSH IPC is used as a  bridge for OS sensor service to control and access PSH
	  sensors communications between kernel and PSH. This is not needed for PC-type
	  machines.

	  Say Y here to get Intel PSH IPC support.

config INTEL_REBOOT_TARGET
	bool "Intel Reboot Target"
	---help---
	  This driver provides a generic implementation for reboot target setting at
	  reset time.

config INTEL_REBOOT_TARGET_PSH_DEBUG
	depends on INTEL_REBOOT_TARGET
	bool "Enable PSH-debug target"
	default n
	---help---
	  Reboot Target which PSH debug port is enabled.

config INTEL_REBOOT_TARGET_SCU_DEBUG
	depends on INTEL_REBOOT_TARGET
	bool "Enable scu-debug target"
	default n
	---help---
	  Reboot Target which scu debug port is enabled.

config INTEL_REBOOT_TARGET_CHANGE_PORT
	depends on INTEL_REBOOT_TARGET
	bool "Enable debug-crd target"
	default n
	---help---
	  Reboot Target which spi debug port is enabled.

config INTEL_REBOOT_TARGET_UEFI
	tristate "Intel Target Mode UEFI implementation"
	depends on INTEL_REBOOT_TARGET && EFI && !MID_OSNIB_ILB
	---help---
	  Reboot Target UEFI based implementation
```

## drivers/external_drivers/drivers/power/ASUS_BATTERY/Kconfig
```kconfig
#
#  Copyright (c) 2013, ASUSTek, Inc. All Rights Reserved.
#  Written by chih-hsuan chang chih-hsuan_chang@asus.com
#
#  Battery driver configuration
#
menuconfig A500CG_BATTERY
	bool "A500CG Battery support"
	help
	  Say Y here. This option doesn't affect the kernel.
	  If unsure, say Y.

menuconfig ASUS_ENGINEER_MODE
	bool "A500CG Battery Engineer Mode"
	help
	  Say Y here. This option doesn't affect the kernel.
	  If unsure, say Y.

if A500CG_BATTERY

config A500CG_BATTERY_SMB347
	tristate "SMB347 battery charger driver"
	depends on I2C
	help
	  Say Y to enable support for the SMB347 switching mode based charger
	  and sysfs. The driver supports controlling charger-enable and
	  current limiting capabilities. The driver also lets the
	  SMB347 be operated as a slave device via the power supply
	  framework.

endif

config UPI_BATTERY
       tristate "UPI uG31xx battery driver"
       depends on I2C
       help
         Say Y to support for batteries with uG31xx chip.
```

## drivers/external_drivers/drivers/pwm/Kconfig
```kconfig
if PWM

config PWM_BYT_CORE
	tristate "Intel Baytrail SoC PWM Core Logic"

	help
	  Core logic for generic PWM framework driver for Intel Baytrail SoC.

	  To compile this driver as a module, choose M here: the module
	  will be called pwm_byt_core.

config PWM_BYT_PCI
	tristate "Intel Baytrail SoC PWM PCI support"
	depends on PWM && PWM_BYT_CORE
	help
	  PCI based generic PWM framework driver for Intel Baytrail SoC.

	  To compile this driver as a module, choose M here: the module
	  will be called pwm-byt.

config PWM_BYT_PLATFORM
	tristate "Intel Baytrail SoC PWM PCI support"
	depends on PWM && PWM_BYT_CORE
	help
	  Platform driver based generic PWM framework driver for Intel Baytrail SoC.

	  To compile this driver as a module, choose M here: the module
	  will be called pwm-byt.
endif

config PWM_WORLD_LED
        tristate "Support for PWM World LED"

        help
        This option enables support for Intel PWM World LED. Say Y
        here if you want to enable the pwm functionality

        To compile this driver as a module, choose M here. The module  will
        be called pwm_world_led.
```

## drivers/external_drivers/drivers/regulator/Kconfig
```kconfig
config REGULATOR_PMIC_AVP
        tristate "PMIC Avondale Cove voltage regulator"
        help
          This driver controls a intel pmic avatele voltage output regulator

config REGULATOR_DOLLAR_COVE
        bool "Voltage regulator driver for DOLLAR COVE PMIC"
        ---help---
           Select for the voltage regulator driver on DOLLAR_COVE PMIC.
           DOLLAR COVE pmic is used in some variation of CHT/BYT/BTNS platforms.
           Choose this if platform has DOLLAR COVE pmic and you need
           voltage regulator driver.
```

## drivers/external_drivers/drivers/staging/sep/Kconfig
```kconfig
config DX_SEP_FORK
	tristate "Fork of Discretix SEP driver"
	depends on PCI && MMC_BLOCK
	help
	  Discretix SEP driver; used for the security processor subsystem
	  on board the Intel Mobile Internet Device and adds SEP availability
	  to the kernel crypto infrastructure

	  The driver's name is sep_driver.

	  If unsure, select N.
config ENABLE_SEP_KERNEL_CRYPTO
	bool "Discretix SEP driver to support Kernel Crypto"
	depends on DX_SEP
	default n
	help
	  Selecting yes (y) on this will enable the Discretix SEP driver to
	  support operation with the Linux kernel crypto infrastructure.

	  This will work only with some Intel Mobeil Internet Device types.

	  If unsure, select N
```

## drivers/external_drivers/drivers/watchdog/Kconfig
```kconfig
config ITCO_WDT_MOD
	tristate "Intel TCO Timer/Watchdog for Baytrail"
	depends on (X86 || IA64) && PCI
	---help---
	  Hardware driver for the intel TCO timer based watchdog devices.
	  These drivers are included in the Intel 82801 I/O Controller
	  Hub family (from ICH0 up to ICH10) and in the Intel 63xxESB
	  controller hub.

	  The TCO (Total Cost of Ownership) timer is a watchdog timer
	  that will reboot the machine after its second expiration. The
	  expiration time can be configured with the "heartbeat" parameter.

	  On some motherboards the driver may fail to reset the chipset's
	  NO_REBOOT flag which prevents the watchdog from rebooting the
	  machine. If this is the case you will get a kernel message like
	  "failed to reset NO_REBOOT flag, reboot disabled by hardware".

	  To compile this driver as a module, choose M here: the
	  module will be called iTCO_wdt.
```
