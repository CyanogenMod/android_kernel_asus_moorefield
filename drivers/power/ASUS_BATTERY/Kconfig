## drivers/power/ASUS_BATTERY/Kconfig
```kconfig
#
#  Copyright (c) 2013, ASUSTek, Inc. All Rights Reserved.
#  Written by chih-hsuan chang chih-hsuan_chang@asus.com
#
#  Battery driver configuration
#
menuconfig ASUS_BATTERY
	bool "ASUS Battery support"
        default y
	help
	  Say Y here. This option doesn't affect the kernel.
	  If unsure, say Y.

menuconfig ASUS_ENGINEER_MODE
	bool "A500CG Battery Engineer Mode"
	default y
	help
	  Say Y here. This option doesn't affect the kernel.
	  If unsure, say Y.

menuconfig ASUS_BATTERY_POWER
        bool "ASUS_BATTERY_POWER support"
        default y
        help
          Say Y here. This option doesn't affect the kernel.
          If unsure, say Y.

if ASUS_BATTERY

config SMB1357_CHARGER
	tristate "SMB1357 battery charger driver"
	help
	  Say Y to enable support for the SMB1357 switching mode based charger
	  and sysfs. The driver supports controlling charger-enable and
	  current limiting capabilities. The driver also lets the
	  SMB1357 be operated as a slave device via the power supply
	  framework.

config A500CG_BATTERY_SMB347
	tristate "SMB347 battery charger driver"
	help
	  Say Y to enable support for the SMB347 switching mode based charger
	  and sysfs. The driver supports controlling charger-enable and
	  current limiting capabilities. The driver also lets the
	  SMB347 be operated as a slave device via the power supply
	  framework.

config BATTERY_MM8033
	tristate "MM8033 battery driver"
	depends on I2C
	help
	  Say Y here to enable support for batteries with MM8033 chips.

config BATTERY_MAX17058
	tristate "Maxim MAX17058 Fuel Gauge"
	depends on I2C
	help
	  MAX17058 is fuel-gauge systems for lithium-ion (Li+) batteries
	  in handheld and portable equipment. The MAX17058 is configured
	  to operate with a single lithium cell.
endif
```

## drivers/power/battery/Kconfig
```kconfig
#
#  Copyright (c) 2013, ASUSTek, Inc. All Rights Reserved.
#  Written by chris chang chris1_chang@asus.com
#
#  Battery driver configuration
#

config ME372CG_BATTERY_SMB345
	tristate "SMB345 battery charger driver"
	depends on I2C && PF450CL
	help
	  Say Y to enable support for the SMB345 switching mode based charger
	  and sysfs. The driver supports controlling charger-enable and
	  current limiting capabilities.

config ME372CG_BATTERY_BQ27520
	tristate "BQ27520 battery driver"
	depends on I2C && PF450CL
	help
	  Say Y here to enable support for batteries with BQ27520(I2C) chips.
```

## drivers/staging/npk/Kconfig
```kconfig
config INTEL_NORTHPEAK
	tristate "North Peak PCI driver"
	depends on PCI
	default n
	---help---
	 North Peak PCI driver for North Peak device configuration
	 and trace access.

config INTEL_NORTHPEAK_UTIL
	tristate "North Peak Utility driver"
	depends on INTEL_NORTHPEAK
	default n
	---help---
	 North Peak utility driver provides register access through
	 ioctl commands to configure the North Peak device.

config INTEL_NORTHPEAK_TRACE
	tristate "North Peak Trace driver"
	depends on INTEL_NORTHPEAK
	default n
	---help---
	 North Peak trace driver provides access to Noth Peak trace
	 buffer through ioctl commands.

config INTEL_NORTHPEAK_EARLY_PRINTK
	tristate "North Peak early printk console"
	depends on INTEL_NORTHPEAK
	default n
	---help---
	 Allows to write early printk messages to North Peak device

config NPK_SW_BAR
	hex "Physical address of the NPK device's SW_BAR "
	depends on INTEL_NORTHPEAK_EARLY_PRINTK
	default 0xb3400000
	---help---
	 This is the physical base address of the NPK device's SW_BAR.
	 This corresponds to the Software Trace Memory Region, i.e. an
	 MMIO space used by software/firmware to send debug messages to
	 North Peak

config NPK_CHANNEL_COUNT
	int "Number of software channels per master"
	depends on INTEL_NORTHPEAK_EARLY_PRINTK
	default 128
	---help---
	 This is the number of software channels per master for the
	 NPK device's software trace hub

config NPK_FIRST_CHANNEL_FOR_EARLY_PRINTK
	int "ID of the first software channel reserved for early printk"
	depends on INTEL_NORTHPEAK_EARLY_PRINTK
	default 23
	---help---
	 This is the ID of the first software channel that is reserved
	 for early printk messages for each logical processor

config NPK_NUM_CHANNELS_FOR_EARLY_PRINTK
	int "Number of software channels reserved for early printk"
	depends on INTEL_NORTHPEAK_EARLY_PRINTK
	default 4
	---help---
	 This is the number of software channels that are reserved
	 for early printk messages for each logical processor

config INTEL_NORTHPEAK_DVC_IO
	tristate "DvC.Trace over NorthPeak"
	depends on USB_G_ANDROID && INTEL_NORTHPEAK_TRACE
	default n
	---help---
	  DvC.Trace will use NorthPeak multi-window buffer
	  and PCI device.
```

## drivers/staging/snappy/Kconfig
```kconfig
config SNAPPY_COMPRESS
	tristate "Google Snappy Compression"
	default y

config SNAPPY_DECOMPRESS
	tristate "Google Snappy Decompression"
	default y
```

## drivers/staging/sventx/Kconfig
```kconfig
config SVENTX
	tristate "SVENTX adaptation layer for the kernel"
	default n
	help
	  SVENTX adaptation layer for the kernel does the binding
	  between SVENTX API and NPK PCI driver

config SVENTX_TEST
	tristate "Test module for SVENTX kernel adaptation layer"
	depends on SVENTX
	default n
	help
	  Test module for the SVENTX adaptation layer
```

## drivers/usb/misc/asus_usb/Anxusb/Kconfig
```kconfig
config SLIMPORT_COLORADO3
	tristate "Analogix Slimport transmitter COLORADO3 support"
	help
        	Slimport Transmitter is a HD video transmitter chip
		over micro-USB connector for smartphone device.
```

## drivers/usb/misc/asus_usb/Kconfig
```kconfig
config USB_FUSB302
	bool "USB FUSB302 driver"
	---help---
	  USB FUSB302 driver.

config SLIMPORT_COLORADO3
	tristate "Analogix Slimport transmitter COLORADO3 support"
	help
        	Slimport Transmitter is a HD video transmitter chip
		over micro-USB connector for smartphone device.
```
