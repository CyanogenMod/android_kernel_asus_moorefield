## arch/x86/hotplug/Kconfig
```kconfig
config ALUCARD_HOTPLUG
	bool "Enable alucard-hotplug cpu hotplug driver"
	default y
	help
	  Alucard-hotplug cpu hotplug driver
```

## drivers/external_drivers/Kconfig
```kconfig
menuconfig EXTERNAL_DRIVERS
	bool "Enable support to external drivers"
	depends on X86
	default y
	help
	  External drivers are drivers located outside this kernel tree
	  but allowed to be configured as builtin.
	  External drivers directories will behave as a regular directory
	  inside kernel tree.

if EXTERNAL_DRIVERS

menuconfig EXTERNAL_MISC_DRIVERS
	bool "Enable support to misc drivers"
	depends on EXTERNAL_DRIVERS
	default y
	help
	  Enable support to external misc drivers.

if EXTERNAL_MISC_DRIVERS
source "drivers/external_drivers/drivers/Kconfig"
endif

menuconfig EXTERNAL_INTEL_MEDIA
	bool "Enable support to intel media drivers"
	depends on EXTERNAL_DRIVERS
	default y
	help
	  Enable support to external intel media drivers.

if EXTERNAL_INTEL_MEDIA
source "drivers/external_drivers/intel_media/Kconfig"
endif

menuconfig EXTERNAL_CAMERA
        bool "Enable support to Intel camera drivers"
        depends on EXTERNAL_DRIVERS
        default n
        help
          Enable support to external Intel camera drivers.

if EXTERNAL_CAMERA
source "drivers/external_drivers/camera/Kconfig"
endif

#menuconfig EXTERNAL_BTNS_CAMERA
#        bool "Enable support to Intel camera drivers"
#        depends on EXTERNAL_DRIVERS
#        default n
#        help
#          Enable support to external Intel camera drivers. camera_icgotm
#	  has the latest icg camera driver to support brighton shores.
#	  It will be used for brighton shores camera only for now.
#	  All others use EXTERMAL_CAMERA instead of this.
#
#if EXTERNAL_BTNS_CAMERA
#source "drivers/external_drivers/camera_icgotm/Kconfig"
#endif

menuconfig EXTERNAL_CAMERA_IPU
        bool "Enable support to Intel camera ipu drivers"
        depends on EXTERNAL_DRIVERS
        default n
        help
          Enable support to external Intel camera ipu drivers.

source "drivers/external_drivers/ipu/Kconfig"

menuconfig EXTERNAL_SILENT_LAKE
        bool "Enable support for silent lake drivers"
        depends on EXTERNAL_DRIVERS
        default n
        help
          Enable support to external Intel silent lake drivers.

source "drivers/external_drivers/silentlake/Kconfig"

endif
```

## drivers/external_drivers/camera/Kconfig
```kconfig
if EXTERNAL_CAMERA
source drivers/external_drivers/camera/drivers/Kconfig
endif

config ION_FOR_CAMERA
	depends on ION
	default n
```

## drivers/external_drivers/camera/drivers/media/i2c/LaserSensor/Kconfig
```kconfig
source "drivers/external_drivers/camera/drivers/media/i2c/LaserSensor/Olivia_msm/Kconfig"
```

## drivers/external_drivers/camera/drivers/media/i2c/LaserSensor/Olivia_msm/Kconfig
```kconfig
config OLIVIA_LASERSENSOR
       tristate "Olivia Laser Sensor support"
       ---help---
         This is a Olivia Laser Sensor driver
```

## drivers/external_drivers/camera/drivers/media/i2c/t4k35/Kconfig
```kconfig
config VIDEO_T4K35
	tristate "Toshiba t4k35 8Mp raw sensor"
	depends on I2C && VIDEO_V4L2
	---help---
	  This is a Video4Linux2 sensor-level driver for the Toshiba
	  RAW sensor.

	  It currently depends on internal V4L2 extensions defined in
	  atomisp driver.
```

## drivers/external_drivers/camera/drivers/media/i2c/t4k37/Kconfig
```kconfig
config VIDEO_T4K37
	tristate "Toshiba t4k37 13Mp raw sensor"
	depends on I2C && VIDEO_V4L2
	---help---
	  This is a Video4Linux2 sensor-level driver for the Toshiba
	  RAW sensor.

	  It currently depends on internal V4L2 extensions defined in
	  atomisp driver.
```

## drivers/external_drivers/camera/drivers/media/pci/Kconfig
```kconfig
#
# Kconfig for ISP driver
#

config VIDEO_ATOMISP
       tristate "Intel Atom Image Signal Processor Driver"
        depends on VIDEO_V4L2
       select VIDEOBUF_VMALLOC
        ---help---
          Say Y here if your platform supports Intel Atom SoC
          camera imaging subsystem.
          To compile this driver as a module, choose M here: the
          module will be called atomisp

config VIDEO_ATOMISP_TMP
       tristate "temporary Kconfig variable for atomisp2"

config VIDEO_ATOMISP_CTP
       tristate "temporary Kconfig variable for atomisp2 on CTP"

source drivers/external_drivers/camera/drivers/media/pci/atomisp2/Kconfig
```

## drivers/external_drivers/camera/drivers/media/pci/atomisp2/Kconfig
```kconfig
#
# Kconfig for ATOMISP driver selection
#

config VIDEO_ATOMISP_CSS2400_V21
       tristate "Intel Atom Image Signal Processor Driver"
        depends on VIDEO_ATOMISP

config VIDEO_ATOMISP_CSS2401_V21
       tristate "Intel Atom Image Signal Processor Driver"
        depends on VIDEO_ATOMISP

config VIDEO_ATOMISP_CSS2401_LEGACY_V21
       tristate "Intel Atom Image Signal Processor Driver"
        depends on VIDEO_ATOMISP
        
config VIDEO_ATOMISP_CSS2300
       tristate "Intel Atom Image Signal Processor Driver"
        depends on VIDEO_ATOMISP
```

## drivers/external_drivers/drivers/Kconfig
```kconfig
source "drivers/external_drivers/drivers/hsi/Kconfig"
source "drivers/external_drivers/drivers/hwmon/Kconfig"
source "drivers/external_drivers/drivers/modem_control/Kconfig"
source "drivers/external_drivers/drivers/modem_ap_cdmp/Kconfig"
source "drivers/external_drivers/drivers/misc/Kconfig"
source "drivers/external_drivers/drivers/i2c/busses/Kconfig"
source "drivers/external_drivers/drivers/input/Kconfig"
source "drivers/external_drivers/drivers/leds/Kconfig"
source "drivers/external_drivers/drivers/lpss/Kconfig"
source "drivers/external_drivers/drivers/nfc/Kconfig"
source "drivers/external_drivers/drivers/power/Kconfig"
source "drivers/external_drivers/drivers/staging/Kconfig"
source "drivers/external_drivers/drivers/pinctrl/Kconfig"
source "drivers/external_drivers/drivers/platform/x86/Kconfig"
source "drivers/external_drivers/drivers/regulator/Kconfig"
source "drivers/external_drivers/drivers/hsu/Kconfig"
source "drivers/external_drivers/drivers/mfd/Kconfig"
source "drivers/external_drivers/drivers/watchdog/Kconfig"
source "drivers/external_drivers/drivers/acpi/Kconfig"
source "drivers/external_drivers/drivers/pwm/Kconfig"
source "drivers/external_drivers/drivers/gps/Kconfig"
```

## drivers/external_drivers/drivers/acpi/Kconfig
```kconfig
config INTEL_MID_LPSS
	bool "Intel MID LPSS ACPI support"
	depends on ACPI
	help
	  This driver is for Intel MID LPSS ACPI support.

	  Say Y here to support Intel MID LPSS ACPI.
```

## drivers/external_drivers/drivers/gps/Kconfig
```kconfig
menuconfig GPS
	bool "Gps Adapters"
	default n
	---help---
	  Say Y here to enable selecting GPS adapters.

if GPS

# Intel MID GPS
source "drivers/external_drivers/drivers/gps/intel_mid_gps/Kconfig"

# TI's ST based wl128x GPS
source "drivers/external_drivers/drivers/gps/wl128x/Kconfig"

endif # GPS
```

## drivers/external_drivers/drivers/gps/intel_mid_gps/Kconfig
```kconfig
#
# Intel MID GPS driver.
#

config INTEL_MID_GPS
	tristate "Intel MID GPS driver"
	default n
	help
	  Select this driver to enable kernel interface for GPS devices
	  used in Intel MID platforms.
	  This driver exports GPIO to user space GPS software
	  that use a standard tty to communicate with the GPS device.

#
# Broadcom BCM4774 GPS driver.
#

config BROADCOM_BCM4774_GPS
	tristate "Broadcom BCM4774 GPS driver"
	depends on SERIAL_MFD_HSU || SERIAL_MFD_HSU_EXT
	default n
	help
	  Select this driver to enable kernel interface for GPS devices
	  used in Broadcom BCM4774 platforms.
	  This driver exports GPIO to user space GPS software
	  that use a standard tty to communicate with the GPS device.

config BROADCOM_BCM4774_GPS_UART_PORT
	int "UART Port (integer)"
	depends on BROADCOM_BCM4774_GPS
	default "2"
```

## drivers/external_drivers/drivers/gps/wl128x/Kconfig
```kconfig
#
# TI's wl128x GPS driver based on TI's ST driver.
#
menu "Texas Instruments WL128x GPS driver (ST based)"
config ST_GPS
	tristate "Texas Instruments WL128x GPS driver"
	select TI_ST
	help
	  This enables the GPS driver for TI WL128x BT/FM/GPS combo devices.
	  It will provide a character device for the TI GPS host software to
	  access the GPS core on the WL128x.
endmenu
```

## drivers/external_drivers/drivers/hsi/Kconfig
```kconfig
#
# HSI driver configuration
#
menuconfig HSI
	tristate "HSI support"
	---help---
	  The "High speed synchronous Serial Interface" is
	  synchronous serial interface used mainly to connect
	  application engines and cellular modems.

if HSI

config HSI_BOARDINFO
	bool
	default y

config HSI_NO_MODEM
	bool "HSI no modem support"
	default n
	help
	  modem switch off

source "drivers/external_drivers/drivers/hsi/controllers/Kconfig"
source "drivers/external_drivers/drivers/hsi/clients/Kconfig"

endif # HSI
```

## drivers/external_drivers/drivers/hsi/clients/Kconfig
```kconfig
#
# HSI clients configuration
#

comment "HSI clients"

config HSI_FFL_TTY
	tristate "Fixed frame length protocol on HSI"
	default n
	depends on HSI
	help
	  If you say Y here, you will enable the fixed frame length protocol
	  driver over an HSI physical link.
	  This driver implements a TTY interface for transferring data over
	  HSI between two devices using a fixed frame length protocol.

	  If unsure, say N.

if HSI_FFL_TTY

config HSI_FFL_TTY_NAME
	string "Base name for the TTY"
	default "IFX"
	help
	  Sets the base name for the TTY associated to this fixed frame length
	  protocol.
	  The base name will be appended to the tty interface used by the HSI
	  fixed frame length protocol.

	  If unsure, use the default value.


config HSI_FFL_TTY_FRAME_LENGTH
	int "Fixed frame length"
	default "4096"
	range 4 131072
	help
	  Sets the fixed frame length in bytes to be used in this protocol
	  driver. This frame length must be a multiple of 4 bytes, set between
	  4 bytes and 128 kiB (131072 bytes).

	  Set to 4096 bytes by default.

config HSI_FFL_TTY_HEADER_LENGTH
	int "Fixed frame header length"
	default "4"
	range 0 4
	help
	  Sets the fixed frame header length in bytes to be used in this
	  protocol driver. This header length must be set to 4 in normal usage
	  or to 0 in raw protocol debug mode.

	  Set to 4 bytes by default.

config HSI_FFL_ENSURE_LAST_WORD_NULL
	bool "Ensuring that all TX FFL frames end with zeros"
	default y
	help
	  If you say Y here, the FFL maximal payload will be reduced by 4 bytes
	  to ensure that the last HSI word is filled with zeros. This feature
	  is ensuring that both the CADATA and CAFLAG signals are low at the
	  end of a FFL frame so that no simultaneous DATA and FLAG transitions
	  can be spotted when the IP is being power-cut.

	  If the attached modem is robust with respect to simultanous DATA and
	  FLAG transition, say N. Otherwise, it is always safer to say Y.


config HSI_FFL_TTY_CHANNEL
	int "HSI channel"
	default "0"
	range 0 15
	help
	  Sets the default single channel index to be used for the FFL protocol.
	  You may need to change this value depending of the implementation of the
	  fixed length frame (FFL) protocol.
	  Set to 0 by default.
	  If unsure, use the default value.


config HSI_FFL_TTY_STATS
	bool "Statistics to assess the performance of the protocol"
	default n
	help
	  If you say Y here, you will instanciate performance related counters
	  for measuring the number of sent and received frames as well as their
	  total actual length in bytes.

	  If not fine-tuning the HSI FFL driver, say N.

endif

config HSI_DLP
	tristate "Data Link Protocol protocol on HSI for LTE IMC modems"
	default n
	depends on HSI
	help
	  If you say Y here, you will enable the DLP protocol for LTE IMC modem
	  over an HSI physical link.
	  This driver implements network interfaces and a TTY interface for
	  transferring data over HSI between an APE and an IMC modem.

	  If unsure, say N.

if HSI_DLP

config HSI_DLP_IPC_TTY_NAME
	string "Base name for the IPC TTY"
	default "IFX"
	help
	  Sets the base name for the TTY associated to this IMC modem protocol
	  for LTE.
	  The base name will be appended to the tty interface used by the HSI
	  eDLP protocol.

	  If unsure, use the default value.

config HSI_FLASHING_DEV_NAME
	string "Base name for the Boot/Flashing driver"
	default "IFX"
	help
	  Sets the base name for the char device associated to this IMC
	  Boot/Flashing protocol. The base name will be appended to the char
	  device interface used by the HSI flashing protocol

	  If unsure, use the default value.

config HSI_TRACE_DEV_NAME
	string "The name for the Modem trace driver"
	default "mdmTrace"
	help
	  Sets the name for the char device associated to this IMC trace protocol

	  If unsure, use the default value.

config HSI_DLP_NET_NAME
	string "Base name for the network interfaces"
	default "rmnet"
	help
	  The base name will be exported by the network interface used by the
	  HSI eDLP protocol

	  If unsure, use the default value.

config HSI_DLP_PDU_LENGTH
	int "Fixed frame length"
	default "4096"
	range 4 131072
	help
	  Sets the fixed frame length in bytes to be used in this protocol
	  driver. This frame length must be a multiple of 4 bytes, set between
	  4 bytes and 128 kiB (131072 bytes).

	  Set to 4096 bytes by default.

config HSI_DLP_TTY_STATS
	bool "Statistics to assess the performance of the protocol (TTY)"
	default n
	help
	  If you say Y here, you will instanciate performance related counters
	  for measuring the number of sent and received frames as well as their
	  total actual length in bytes.

	  If not fine-tuning the HSI IMC LTE driver, say N.

config HSI_DLP_HEADER_LENGTH
	int "Fixed frame header length"
	default "4"
	range 0 4
	help
	  Sets the fixed frame header length in bytes to be used in this
	  protocol driver. This header length must be set to 4 in normal usage
	  or to 0 in raw protocol debug mode.

	  Set to 4 bytes by default.

endif

config HSI_LOGICAL
	tristate "Data Link Protocol protocol on HSI for RMC modems"
	default n
	depends on HSI
	help
	  If you say Y here, you will enable the DLP protocol for RMC modem
	  over an HSI physical link.

	  If unsure, say N.

config HSI_RMC_VERSION
	int "HSI version (2 or 3 supported)"

	depends on HSI_LOGICAL
	default "3"
	help
	  Specifies the HSI version used to communicate with the RMC
	  modem. Version 3 supports 3bits of channel and the Management
	  of HSI_POWER_OFF message.
```

## drivers/external_drivers/drivers/hsi/controllers/Kconfig
```kconfig
#
# HSI controllers configuration
#
comment "HSI controllers"

config HSI_ARASAN
	tristate "intel_mid_hsi HSI hardware driver"
	depends on HSI
	default n
	help
	  If you say Y here, you will enable the intel_mid_hsi HSI hardware
	  driver.

	  If unsure, say N.

if HSI_ARASAN

config HSI_ARASAN_CONFIG
	boolean
	default y

config HSI_WAKEUP_PACKET_DUMP_LEN
	int "HSI Wakeup packet dump length"
	depends on HSI_ARASAN
	range 4 8192
	default "20"
	help
		Setting value greater than zero Will enable the dump of the first packet
		received after the HSI controller wakeup

		If unsure, keep default value (20)

endif # HSI_ARASAN
```
